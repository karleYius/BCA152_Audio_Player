#pragma once
#include <cstdint>
#include <cstring>
#include "driver/i2c_master.h"
#include "esp_log.h"

namespace app
{
    class Ssd1306
    {
    public:
        static constexpr int WIDTH = 128;
        static constexpr int HEIGHT = 64;

    private:
        i2c_master_bus_handle_t m_bus = nullptr;
        i2c_master_dev_handle_t m_dev = nullptr;
        uint8_t m_buf[WIDTH * HEIGHT / 8];

        void cmd(uint8_t c)
        {
            uint8_t d[2] = {0x00, c};
            esp_err_t err = i2c_master_transmit(m_dev, d, 2, 100);
            if (err != ESP_OK)
            {
                ESP_LOGE("oled", "I2C command failed: %s", esp_err_to_name(err));
            }
        }

        static const uint8_t *glyph(char c)
        {
            static const uint8_t FONT[][5] = {
                {0x00, 0x00, 0x00, 0x00, 0x00}, {0x00, 0x00, 0x5F, 0x00, 0x00}, {0x00, 0x07, 0x00, 0x07, 0x00},
                {0x14, 0x7F, 0x14, 0x7F, 0x14}, {0x24, 0x2A, 0x7F, 0x2A, 0x12}, {0x23, 0x13, 0x08, 0x64, 0x62},
                {0x36, 0x49, 0x56, 0x20, 0x50}, {0x00, 0x08, 0x07, 0x03, 0x00}, {0x00, 0x1C, 0x22, 0x41, 0x00},
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                {0x44, 0x64, 0x54, 0x4C, 0x44}};
            if (c < 32 || c > 122)
            {
                c = '?';
            }
            return FONT[c - 32];
        }

    public:
        void init(gpio_num_t sda, gpio_num_t scl, uint8_t addr)
        {
            i2c_master_bus_config_t bus_cfg = {};
            bus_cfg.i2c_port = I2C_NUM_0;
            bus_cfg.sda_io_num = sda;
            bus_cfg.scl_io_num = scl;
            bus_cfg.clk_source = I2C_CLK_SRC_DEFAULT;
            bus_cfg.glitch_ignore_cnt = 7;
            bus_cfg.flags.enable_internal_pullup = true;
            ESP_ERROR_CHECK(i2c_new_master_bus(&bus_cfg, &m_bus));

            i2c_device_config_t dev_cfg = {};
            dev_cfg.dev_addr_length = I2C_ADDR_BIT_LEN_7;
            dev_cfg.device_address = addr;
            dev_cfg.scl_speed_hz = 400000;
            ESP_ERROR_CHECK(i2c_master_bus_add_device(m_bus, &dev_cfg, &m_dev));

            const uint8_t seq[] = {0xAE, 0xD5, 0x80, 0xA8, 0x3F, 0xD3, 0x00, 0x40,
                                   0x8D, 0x14, 0x20, 0x00, 0xA1, 0xC8, 0xDA, 0x12,
                                   0x81, 0xCF, 0xD9, 0xF1, 0xDB, 0x40, 0xA4, 0xA6, 0xAF};
            for (uint8_t c : seq)
            {
                cmd(c);
            }
            clear();
            flush();
        }

        void clear() { memset(m_buf, 0, sizeof(m_buf)); }

        void flush()
        {
            cmd(0x21);
            cmd(0);
            cmd(WIDTH - 1);
            cmd(0x22);
            cmd(0);
            cmd(7);
            uint8_t tx[1 + WIDTH];
            tx[0] = 0x40;
            for (int page = 0; page < 8; page++)
            {
                memcpy(tx + 1, &m_buf[page * WIDTH], WIDTH);
                i2c_master_transmit(m_dev, tx, sizeof(tx), 100);
            }
        }

        void pixel(int x, int y, bool on)
        {
            if (x < 0 || x >= WIDTH || y < 0 || y >= HEIGHT)
            {
                return;
            }
            uint8_t &b = m_buf[(y / 8) * WIDTH + x];
            if (on)
            {
                b |= (1 << (y % 8));
            }
            else
            {
                b &= ~(1 << (y % 8));
            }
        }

        void fillRect(int x, int y, int w, int h, bool on)
        {
            for (int j = 0; j < h; j++)
            {
                for (int i = 0; i < w; i++)
                {
                    pixel(x + i, y + j, on);
                }
            }
        }

        void drawRect(int x, int y, int w, int h, bool on)
        {
            for (int i = 0; i < w; i++)
            {
                pixel(x + i, y, on);
                pixel(x + i, y + h - 1, on);
            }
            for (int j = 0; j < h; j++)
            {
                pixel(x, y + j, on);
                pixel(x + w - 1, y + j, on);
            }
        }

        int textWidth(const char *s, int scale) const
        {
            int n = (int)strlen(s);
            return n == 0 ? 0 : n * 6 * scale - scale;
        }

        void drawText(int x, int y, const char *s, int scale, bool on)
        {
            for (; *s; s++)
            {
                const uint8_t *g = glyph(*s);
                for (int col = 0; col < 5; col++)
                {
                    for (int row = 0; row < 7; row++)
                    {
                        if (g[col] & (1 << row))
                        {
                            fillRect(x + col * scale, y + row * scale, scale, scale, on);
                        }
                    }
                }
                x += 6 * scale;
            }
        }
    };
}